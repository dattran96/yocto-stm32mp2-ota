## conf/distro/mydistro.conf
```bitbake
require conf/distro/poky.conf

DISTRO = "mydistro"
DISTRO_NAME = "My Learning Distro"
DISTRO_VERSION = "1.4"
DISTRO_CODENAME = "learning"
MAINTAINER = "Dat Tran <t.ng.t.dat@gmail.com>"

INIT_MANAGER = "systemd"
DISTRO_FEATURES:append = " rauc"
```
